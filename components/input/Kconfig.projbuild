## components/input/Kconfig.projbuild
```kconfig
menu "Input HAL"

    choice INPUT_BACKEND
        prompt "Input backend"
        default INPUT_AUTO
        help
            Select which input backend(s) to compile and initialise.
            AUTO enables both BLE HID and USB-Serial-JTAG simultaneously.

        config INPUT_AUTO
            bool "AUTO (BLE HID + USB-Serial-JTAG)"

        config INPUT_BLE
            bool "BLE HID only"

        config INPUT_UART
            bool "USB-Serial-JTAG only"
    endchoice

    config INPUT_BLE_SCAN_DURATION
        int "BLE scan duration (seconds)"
        depends on INPUT_BLE || INPUT_AUTO
        default 10
        range 1 60
        help
            How long each scan window lasts before giving up and waiting
            for the next reconnect attempt.

    config INPUT_TOUCH
        bool "Enable GT911 touch input backend"
        default y

    config INPUT_TOUCH_I2C_PORT
        int "I2C port number for GT911"
        default 0
        depends on INPUT_TOUCH

    config INPUT_TOUCH_SDA_PIN
        int "SDA GPIO pin for GT911"
        default 19
        depends on INPUT_TOUCH

    config INPUT_TOUCH_SCL_PIN
        int "SCL GPIO pin for GT911"
        default 20
        depends on INPUT_TOUCH

endmenu
```

## components/vterm/Kconfig.projbuild
```kconfig
menu "vterm"

    config VTERM_BUF_SIZE
        int "Write buffer size (bytes)"
        default 256
        help
            Internal accumulation buffer for vterm_write().

    config VTERM_BENCH
        bool "Enable performance instrumentation"
        default n
        help
            Accumulates cycle counts and byte statistics across flush calls.
            Call vterm_bench_report() to log a summary.
            Zero overhead when disabled.

endmenu
```
